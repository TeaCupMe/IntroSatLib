//Подключаем библиотек
#include <MotorFlyWheel.h>
#include <IS_Bluetooth.h>

/**
 * Подключение пространства имён библиотеки,
 * чтобы постоянно не писать IntroSatLib::
 */
using namespace IntroSatLib;

//Создание объекта маховика с адресом 0x38
MotorFlyWheel motor(Wire, 0x38);

//Создаение переменных для задания требуемой и текущей скоростей
int16_t needSpeed = 0;
int16_t curSpeed = 0;

void setup() {
  // Включение Serial для вывода данных
  Serial.begin(115200, SERIAL_8E1);

  // Инициализация Wire - I2C1
  Wire.begin();

  // Инициализация маховика
  uint8_t status = motor.Init();

  /** Проверка успешной инициализации. 
	 *  	0 - Инициализция успешна
	 *		1-3 - Ошибка инициализации 
	 */
  if (status != 0) {
    Serial.print("Ошибка инициализации маховика! Код ошибки: ");
    Serial.println(status);
    Serial.println("Проверьте подключение и адрес маховика!");
    // Если маховик не инициализирован - уходим в бесконечный цикл
    while (1)
      ;
  }
}

// Бесконечный цикл - основной код программы
void loop() {
  // Разгоняем двигатель-маховик против ч.с. до 3000 об/мин
  // В переменной needSpeed задаётся скорость вращения в об/мин
  needSpeed = 3000;
  // Установка требуемой скорости маховика
  motor.NeedSpeed(needSpeed);

  Serial.println("Вращение против часовой стрелки");
  Serial.println("Текущая скорость маховика:");
  /** 
   *  В цикле считывается реальная текущая скорость маховика, 
   *  пока она не сравняется с требуемым значением
   */
  while (curSpeed < 3000) {
    // Вызов метода для получения текущей скорости вращения
    curSpeed = motor.CurrentSpeed();
    // Вывод текущей скорости в монитор порта
    Serial.println(curSpeed);
    // Задержка, чтобы маховик успел разогнаться
    delay(500);
  }

  // Останавливаем маховик
  needSpeed = 0;
  // Для остановки маховика ему необходимо задать скорость 0
  motor.NeedSpeed(needSpeed);
  /** 
   *  В цикле считывается реальная текущая скорость маховика, 
   *  пока маховик не будет остановлен
   */
  Serial.println("Остановка маховика");
  Serial.println("Текущая скорость маховика:");
  while (curSpeed > 0) {
    // Вызов метода для получения текущей скорости вращения
    curSpeed = motor.CurrentSpeed();
    // Вывод текущей скорости в монитор порта
    Serial.println(curSpeed);
    // Задержка, чтобы маховик успел остановиться
    delay(500);
  }

  // Разгоняем двигатель-маховик по ч.с. до 3000 об/мин
  // Чтобы маховик вращался в обратную сторону, используем отрицательные числа
  needSpeed = -3000;
  // Установка требуемой скорости маховика
  motor.NeedSpeed(needSpeed);

  Serial.println("Вращение по часовой стрелке");
  Serial.println("Текущая скорость маховика:");
  /** 
   *  В цикле считывается реальная текущая скорость маховика, 
   *  пока она не сравняется с требуемым значением
   */
  while (curSpeed > -3000) {
    // Вызов метода для получения текущей скорости вращения
    curSpeed = motor.CurrentSpeed();
    // Вывод текущей скорости в монитор порта
    Serial.println(curSpeed);
    // Задержка, чтобы маховик успел остановиться
    delay(500);
  }


  // Останавливаем маховик
  needSpeed = 0;
  // Для остановки маховика ему необходимо задать скорость 0
  motor.NeedSpeed(needSpeed);
  /** 
   *  В цикле считывается реальная текущая скорость маховика, 
   *  пока маховик не будет остановлен
   */
  Serial.println("Остановка маховика");
  Serial.println("Текущая скорость маховика:");
  while (curSpeed > 0) {
    // Вызов метода для получения текущей скорости вращения
    curSpeed = motor.CurrentSpeed();
    // Вывод текущей скорости в монитор порта
    Serial.println(curSpeed);
    // Задержка, чтобы маховик успел остановиться
    delay(500);
  }

  // Проверяем, не пришёл ли запрос на переход в режим перепрошивки
  if (Serial.available()) {
    if (Serial.read() == 'b') {
      // Если пришёл символ 'b', переходим в режим перепрошивки
      enter_bootloader();
    }
  }
}
