// Подключаем библиотеку для перепрошивки пикосата по Bluetooth
#include <IS_Bluetooth.h>
// Подключаем библиотеку для управления поворотным стендом
#include <PicoStand.h>
// Подключаем библиотеку для обмена данными по I2C
#include <Wire.h>

// Включаем пространство имён библиотеки для работы с пикосатами (и кубсатами тоже :))
using namespace IntroSatLib;

// Создаём объект для управления поворотным стендом
//    PicoStand - название класса для управления поворотным стендом
//    Wire - объект для управления шиной I2C пикосата
//    0x25 - адрес, по которому можно общаться с поворотным стендом 
PicoStand stand(Wire, 0x25);

void setup() {
  // Инициализируем обмен данными с пикоспутником по UART 
  // 57600 - скорость обмена данными, измеряется в бод (биты в секунду)
  Serial.begin(57600);
  //  Инициализируем работу с I2C
  Wire.begin();

  // Инициализируем поворотный стенд. 
  // Если при инициализации произошла ошибка,
  // выводим соответствующее сообщение.
  if (stand.Init() != 0) {
    Serial.println("Ошибка! Не удалось инициализировать стенд!");
  }
  // Если поворотный стенд готов к работе, 
  // поворачиваем стенд в положение 90 градусов.
  else {
    // SetAngle() - метод для задания угла.
    // 90 - аргумент метода, число в градусах, относящееся к типу данных float.
    // Стенд может встать в любую позицию между 0 и 360 градусами.
    stand.SetAngle(90);
  }
}

void loop() {
  // Проверяем, было ли что-нибудь отправлено в монитор порта по UART
  if (Serial.available()) {
    // Создаём переменную типа String для хранения текстовых строк и
    // считываем в неё строку, отправленную в монитор порта.
    String msg = Serial.readString();
    // Отправляем в монитор порта символ b, чтобы прошивать пикосат по Bluetooth. 
    // После отправки b пикосат перестанет выполнять код и будет ожидать перепрошивки.
    if (msg == "b") {
      EnterBootloader();
    }
    // Подобными условиями можно придумывать свои команды, отправляемые пикосату по Bluetooth.
    // Например, пропишем в коде, что если пикосат получает команду "pos", 
    // то он должен отправить в ответ текущий угол поворота стенда.
    else if (msg == "pos") {
      // GetAngle() - метод для получения текущего угла поворотного стенда.
      // Возвращает значение типа данных float.
      Serial.println(stand.GetAngle());
    }
  }

  // Задание для самопроверки:
  // Придумайте название команды, которая будет возвращать поворотный стенд в нулевое положение.
  // Реализуйте поворот стенда в положение 0 при приёме такой команды по Bluetooth.
}
