// Подключаем библиотеку для перепрошивки пикосата по Bluetooth
#include <IS_Bluetooth.h>
// Подключаем библиотеку для работы с АЦП
#include "PicoADC.h"

// Включаем пространство имён библиотеки для работы с пикосатами (и кубсатами тоже :))
using namespace IntroSatLib;


// Создаём объект для управления АЦП
//    PicoADC - название класса для управления АЦП на плате питания (с ионисторами или с аккумулятором)
//    Wire - объект для управления шиной I2C пикосата 
PicoADC adc(Wire);

void setup() {
  // Инициализируем обмен данными с пикоспутником по UART
  // 57600 - скорость обмена данными, измеряется в бод (биты в секунду)
  Serial.begin(57600);

  //  Инициализируем работу с I2C
  Wire.begin();

  // Инициализируем АЦП. 
  // Если при инициализации произошла ошибка,
  // выводим соответствующее сообщение.
  if (adc.Init() != 0) {
    Serial.println("Ошибка! Не удалось инициализировать ацп!");
  }

  // Метод print() позволяет выводить в монитор порта
  // переменные и константы почти любых типов данных
  Serial.println("Привет, пикосат!");
}

void loop() {
   // Проверяем, было ли что-нибудь отправлено в монитор порта по UART
  if (Serial.available()) {
    // Создаём переменную типа String для хранения текстовых строк и
    // считываем в неё строку, отправленную в монитор порта.
    String msg = Serial.readString();
    // Отправляем в монитор порта символ b, чтобы прошивать пикосат по Bluetooth. 
    // После отправки b пикосат перестанет выполнять код и будет ожидать перепрошивки.
    if (msg == "b") {
      EnterBootloader();
    }

    // Подобными условиями можно придумывать свои команды, отправляемые пикосату по Bluetooth.
    // Например, пропишем в коде, что если пикосат получает команду "bat", 
    // то он должен отправить в ответ напряжение на источнике питания - ионисторах
    else if (msg == "bat") {
      // GetVBAT() - метод для получения значения напряжения на аккумуляторе или ионисторах в вольтах
      // Возвращает значение типа данных float.
      Serial.print("VBAT [V]: ");
      Serial.println(adc.GetVBAT());
    }
    
    // Если получаем команду "icon", 
    // то отправляем в ответ ток потребления
    else if (msg == "icon") {
      // GetCOUT() - метод для получения значения тока потребления с платы питания в миллиамперах
      // Возвращает значение типа данных float.
      Serial.print("I consumption [mA]: ");
      Serial.println(adc.GetCOUT());
    }

    // Если получаем команду "ich", 
    // то отправляем в ответ ток зарядки
    else if (msg == "ich") {
      // GetCIN() - метод для получения тока зарядки с платы питания в миллиамперах
      // Возвращает значение типа данных float.
      Serial.print("I charge [mA]: ");
      Serial.println(adc.GetCIN());
    }

    // Если получаем команду "vin", 
    // то отправляем в ответ ток зарядки
    else if (msg == "vin") {
      // GetVIN() - метод для получения напряжения на солнечных панелях с платы питания в вольтах
      // Возвращает значение типа данных float.
      Serial.print("VIN [V]: ");
      Serial.println(adc.GetVIN());
    }

    // Если получаем команду "vout", 
    // то отправляем в ответ ток зарядки
    else if (msg == "vout") {
      // GetVOUT() - метод для получения напряжения на выходе преобразователя на плате питания в вольтах
      // Возвращает значение типа данных float.
      Serial.print("VOUT [V]: ");
      Serial.println(adc.GetVOUT());
    } 
  }
}