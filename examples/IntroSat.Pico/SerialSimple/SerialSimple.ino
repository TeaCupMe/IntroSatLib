// Подключаем библиотеку для перепрошивки пикосата по Bluetooth
#include <IS_Bluetooth.h>

// Включаем пространство имён библиотеки для работы с пикосатами (и кубсатами тоже :))
using namespace IntroSatLib;

void setup() {
  // Инициализируем обмен данными с пикоспутником по UART
  // 57600 - скорость обмена данными, измеряется в бод (биты в секунду)
  Serial.begin(57600);
  // Метод print() позволяет выводить в монитор порта
  // переменные и константы почти любых типов данных
  Serial.print("Привет, ");
  // А метод println() ещё и переводит курсор на новую строку,
  // как будто была нажата клавиша Enter.
  Serial.println("пикосат!");
}

void loop() {
  // Проверяем, было ли что-нибудь отправлено в монитор порта по UART
  if (Serial.available()) {
    // Создаём переменную типа String для хранения текстовых строк и
    // считываем в неё строку, отправленную в монитор порта.
    String msg = Serial.readString();
    // Отправляем в монитор порта символ b, чтобы прошивать пикосат по Bluetooth.
    // После отправки b пикосат перестанет выполнять код и будет ожидать перепрошивки.
    if (msg == "b") {
      EnterBootloader();
    }
    // Если в монитор порта пришла команда "number",
    // будем ожидать следующим сообщением ввода числа
    else if (msg == "number") {
      // Ожидаем, пришло ли что-то в монитор порта
      // Метод available() возвращает 0, если ничего не пришло
      while (Serial.available() == 0)
        // В теле цикла ничего не делаем - просто ждём,
        // что в монитор порта будет отправлено число
        ;
      // Если отправить целове число, метод parseInt()
      // вернёт его как число типа данных int.
      // Если было отправлено не число, то вернётся ноль.
      // Сохраним возвращаемое значение в переменную типа данных int
      int myNumber = Serial.parseInt();
      // Проверяем, что число записалось в переменную корректно
      Serial.print("Вы ввели число: ");
      Serial.println(myNumber);
    } else {
      // На случай опечаток просто выводим в монитор порта отправленное сообщение
      Serial.print("Вы ввели неизвестную команду: ");
      Serial.println(msg);
    }
  }

  // Задание для самопроверки:
  // Найдите в интернете информацию о методе Serial.readStringUntil().
  // Может ли этот метод быть полезен для унификации команд, после которых нужно ввести число?
  // Найдите в интернете информацию о методе Serial.parseFloat().
  // Попробуйте считать из монитора порта дробное число.
}
