// Подключаем библиотеку для перепрошивки пикосата по Bluetooth
#include <IS_Bluetooth.h>
// Подключаем библиотеку для работы с АЦП
#include "ADS7830.h"

// Включаем пространство имён библиотеки для работы с пикосатами (и кубсатами тоже :))
using namespace IntroSatLib;


// Создаём объект для управления АЦП
//    ADS7830 - название класса для управления АЦП
//    Wire - объект для управления шиной I2C пикосата 
ADS7830 adc(Wire);

void setup() {
  // Инициализируем обмен данными с пикоспутником по UART
  // 57600 - скорость обмена данными, измеряется в бод (биты в секунду)
  Serial.begin(57600);

  //  Инициализируем работу с I2C
  Wire.begin();


  // Инициализируем АЦП. 
  // Если при инициализации произошла ошибка,
  // выводим соответствующее сообщение.
  if (adc.Init() != 0) {
    Serial.println("Ошибка! Не удалось инициализировать ацп!");
  }
  // Метод print() позволяет выводить в монитор порта
  // переменные и константы почти любых типов данных
  Serial.print("Привет, пикосат!");
}

void loop() {
   // Проверяем, было ли что-нибудь отправлено в монитор порта по UART
  if (Serial.available()) {
    // Создаём переменную типа String для хранения текстовых строк и
    // считываем в неё строку, отправленную в монитор порта.
    String msg = Serial.readString();
    // Отправляем в монитор порта символ b, чтобы прошивать пикосат по Bluetooth. 
    // После отправки b пикосат перестанет выполнять код и будет ожидать перепрошивки.
    if (msg == "b") {
      EnterBootloader();
    }

    // Подобными условиями можно придумывать свои команды, отправляемые пикосату по Bluetooth.
    // Например, пропишем в коде, что если пикосат получает команду "bat", 
    // то он должен отправить в ответ напряжение на источнике питания - ионисторах
    else if (msg == "bat") {
      // GetValue(<коэффициент>, <канал>) - метод для получения значения напряжения на канале АЦП.
      // Возвращает значение типа данных float.
      // (1/0.585) - коэффициент для пересчёта "сырых" данных в вольты, для каждого канала он свой 
      // ADS7830::Channel::CH1 - канал 1 на АЦП
      Serial.println(adc.GetValue((1 / 0.585), ADS7830::Channel::CH1));
    }
    
    // Если получаем команду "icon", 
    // то отправляем в ответ ток потребления
    else if (msg == "icon") {
      // GetValue(<коэффициент>, <канал>) - метод для получения значения напряжения на канале АЦП.
      // Возвращает значение типа данных float.
      // (1000/6.2) - коэффициент для пересчёта "сырых" данных в вольты, для каждого канала он свой 
      // ADS7830::Channel::CH4 - канал 1 на АЦП
      Serial.println(adc.GetValue((1000/6.2), ADS7830::Channel::CH4));
    }

    // Если получаем команду "ich", 
    // то отправляем в ответ ток зарядки
    else if (msg == "ich") {
      // GetValue(<коэффициент>, <канал>) - метод для получения значения напряжения на канале АЦП.
      // Возвращает значение типа данных float.
      // (1000/6.2) - коэффициент для пересчёта "сырых" данных в вольты, для каждого канала он свой 
      // ADS7830::Channel::CH3 - канал 1 на АЦП
      Serial.println(adc.GetValue((1000/6.2), ADS7830::Channel::CH3));
    }
  }

  // Задание для самопроверки:
  // Придумайте название команды, которая будет возвращать напряжение на солнечных панелях
  // Реализуйте эту команду
  
  // Подсказка:
  // Соответствие каналов АЦП и данных, которые можно с них получить
  //        Канал             |   Коэффициент   |   Данные
  //  ADS7830::Channel::CH0   |       (4)       |   Напряжение на солнечных панелях в вольтах
  //  ADS7830::Channel::CH1   |   (1 / 0.585)   |   Напряжение на ионисторах в вольтах
  //  ADS7830::Channel::CH2   |   (1 / 0.585)   |   Напряжение на преобразователе напряжения в вольтах
  //  ADS7830::Channel::CH3   |  (1000 / 6.20)  |   Ток зарядки в миллиамперах
  //  ADS7830::Channel::CH4   |  (1000 / 6.20)  |   Ток потребления в миллиамперах
}
